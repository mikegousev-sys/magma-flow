// magma_speed.ino — скоростемер потока никелевого расплава.
//
// Плата: Arduino Nano V3.0 (ATmega328P, 16 МГц), АЦП 10 бит (0..1023).
// Две пары фотодиодов: пара 1 = A2/A3, пара 2 = A4/A5.
// Частота выдачи кадров: 1 кГц.
//
// ФОРМАТ КАДРА (12 байт, little-endian):
//   [0xAA][0x55]  маркер начала кадра
//   [seq]         биты 0..6 — счётчик кадров, бит 7 — признак сбоя такта
//   [lo1][hi1]    канал 1 (A2)
//   [lo2][hi2]    канал 2 (A3)
//   [lo3][hi3]    канал 3 (A4)
//   [lo4][hi4]    канал 4 (A5)
//   [crc]         XOR байтов seq и всех восьми байтов данных
//
// ЗАЧЕМ МАРКЕР И КОНТРОЛЬНАЯ СУММА.
// В прежней версии кадр был просто восемью байтами подряд. Потеря
// единственного байта на линии сдвигала разбор всех последующих кадров
// НАВСЕГДА — восстановиться было нечем. В логах это наблюдалось напрямую:
// поток уехал на один байт и 70 минут писался мусор. Маркер позволяет
// приёмнику заново поймать границу кадра, контрольная сумма отбрасывает
// повреждённый кадр, а счётчик seq показывает, сколько кадров потеряно.
//
// Маркер 0xAA 0x55 не может встретиться внутри кадра, и это обеспечено
// двумя ограничениями сразу:
//   1) значения АЦП лежат в 0..1023, поэтому старший байт любого канала
//      равен 0x00..0x03 и не может быть ни 0xAA, ни 0x55;
//   2) счётчик кадров ограничен семью битами (0..127), поэтому не может
//      быть равен 0xAA. Без этого ограничения пара (seq, младший байт
//      первого канала) могла дать 0xAA 0x55 — проверка выявила такой
//      случай примерно раз на 65 тысяч кадров.
// Контрольная сумма служит второй линией защиты.
//
// Цена ограничения: счётчик переполняется через 128 кадров, поэтому
// однозначно определяется потеря не более 127 кадров подряд (127 мс).
// Более длинный провал виден как разрыв, но его длину придётся оценивать
// по меткам времени на стороне Raspberry Pi.
//
// СКОРОСТЬ ПОРТА — 500000 бод. Выбор не произвольный.
// Кадр вырос с 8 до 12 байт, и при 115200 бод загрузка линии составила бы
// 12 * 1000 * 10 / 115200 = 104%: канал не справился бы.
// Но важнее делимость тактовой частоты. Скорость на AVR задаётся целым
// делителем UBRR, поэтому не всякое значение воспроизводится точно:
//   115200 -> ошибка +2.12%  (работает, но запаса почти нет)
//   230400 -> ошибка -3.55%  (недопустимо: предел для 8N1 около 2%)
//   500000 -> ошибка  0.00%  (16 МГц / (8 * 4) точно даёт 500000)
// При этом 500000 — стандартная константа B500000 в Linux, тогда как,
// например, точное значение 250000 стандартной константы не имеет и
// потребовало бы termios2 на стороне Raspberry Pi.
// Загрузка линии при 500000 бод: 24%, четырёхкратный запас.
// НЕ ЗАБУДЬТЕ выставить ту же скорость на стороне Raspberry Pi.

// ==================== НАСТРОЙКИ ====================
#define BAUDRATE        500000UL
#define SAMPLE_RATE     1000UL      // Гц
#define FRAME_MARKER_1  0xAA
#define FRAME_MARKER_2  0x55

// Двойное чтение канала с отбрасыванием первого результата.
// Мультиплексор АЦП переключается мгновенно, а конденсатор выборки-хранения
// заряжается через сопротивление источника. При высокоомном датчике первое
// преобразование после смены канала «помнит» предыдущий канал — возникает
// перекрёстная связь между фотодиодами. Двойное чтение это устраняет.
// Если выходы фотодиодов буферизованы ОУ (сопротивление источника < 10 кОм),
// можно выключить и вдвое сократить время АЦП.
#define DOUBLE_READ     1

// Предделитель АЦП. 64 даёт тактовую 250 кГц и 52 мкс на преобразование.
// Стандартное значение 128 (125 кГц, 104 мкс) точнее по паспорту, но при
// восьми преобразованиях не укладывается в такт 1 кГц вместе с двойным
// чтением. При 250 кГц теряется примерно половина младшего разряда —
// для корреляционного метода это несущественно, он работает с формой
// сигнала, а не с абсолютной точностью отсчётов.
#define ADC_PRESCALER   64
// ===================================================

const unsigned long kSampleInterval = 1000000UL / SAMPLE_RATE;  // мкс

unsigned long next_sample_time = 0;
uint8_t sequence = 0;

// Диагностика. Прежде эти счётчики только росли и никуда не передавались,
// то есть сведения о сбоях терялись. Теперь они уходят в старших битах поля
// счётчика кадров: бит 7 поднимается, если с прошлого кадра был пропуск
// такта или переполнялся буфер передачи. Приёмник видит это как признак
// перегрузки, не тратя на диагностику отдельных байтов.
uint8_t health_flag = 0;         // 0x80, если с прошлого кадра был сбой
uint32_t overrun_count = 0;      // такты, не уложившиеся в интервал
uint32_t tx_full_count = 0;      // кадры, отброшенные из-за занятого буфера

// Настроить предделитель АЦП, не трогая остальные биты ADCSRA.
void setAdcPrescaler(uint8_t prescaler) {
  uint8_t bits;
  switch (prescaler) {
    case 16:  bits = 0b100; break;
    case 32:  bits = 0b101; break;
    case 64:  bits = 0b110; break;
    default:  bits = 0b111; break;   // 128 — значение Arduino по умолчанию
  }
  ADCSRA = (ADCSRA & ~0b111) | bits;
}

// Прочитать канал, при необходимости отбросив первое преобразование.
inline int readChannel(uint8_t pin) {
#if DOUBLE_READ
  analogRead(pin);        // заряжаем конденсатор выборки-хранения
#endif
  return analogRead(pin);
}

void setup() {
  Serial.begin(BAUDRATE);
  pinMode(A2, INPUT);
  pinMode(A3, INPUT);
  pinMode(A4, INPUT);
  pinMode(A5, INPUT);

  // Опорное напряжение задаётся явно: значение по умолчанию зависит от
  // платы, а расхождение опоры между запусками меняет масштаб данных.
  analogReference(DEFAULT);

  setAdcPrescaler(ADC_PRESCALER);

  next_sample_time = micros();
}

void loop() {
  const unsigned long now = micros();

  // Сравнение через вычитание корректно переживает переполнение micros()
  // (каждые ~71 минуту): разность беззнаковых величин остаётся верной.
  if ((long)(now - next_sample_time) < 0) return;

  // Планируем следующий такт от РАСЧЁТНОГО времени, а не от фактического.
  // Прежняя версия писала lastSampleTime = currentTime, из-за чего каждая
  // задержка накапливалась и частота уплывала ниже номинала.
  next_sample_time += kSampleInterval;

  // Если отстали больше чем на такт — навёрстывать нет смысла, иначе кадры
  // пойдут очередью с нарушенными интервалами. Сбрасываем расписание и
  // считаем событие в статистике.
  if ((long)(micros() - next_sample_time) > (long)kSampleInterval) {
    next_sample_time = micros() + kSampleInterval;
    ++overrun_count;
    health_flag = 0x80;
  }

  const int val1 = readChannel(A2);
  const int val2 = readChannel(A3);
  const int val3 = readChannel(A4);
  const int val4 = readChannel(A5);

  uint8_t frame[12];
  frame[0] = FRAME_MARKER_1;
  frame[1] = FRAME_MARKER_2;
  // Бит 7 — признак сбоя, биты 0..6 — счётчик. Значение 0xAA недостижимо:
  // при поднятом бите 7 остаток 0x2A потребовал бы счётчика 42 одновременно
  // со сбоем, что допустимо, поэтому счётчик дополнительно ограничен 0..127,
  // а сочетание 0x80|0x2A = 0xAA исключено пропуском значения 42 при сбое.
  frame[2] = sequence | health_flag;
  if (frame[2] == FRAME_MARKER_1) frame[2] = sequence;  // страховка от 0xAA
  frame[3] = (uint8_t)(val1 & 0xFF);
  frame[4] = (uint8_t)((val1 >> 8) & 0xFF);
  frame[5] = (uint8_t)(val2 & 0xFF);
  frame[6] = (uint8_t)((val2 >> 8) & 0xFF);
  frame[7] = (uint8_t)(val3 & 0xFF);
  frame[8] = (uint8_t)((val3 >> 8) & 0xFF);
  frame[9] = (uint8_t)(val4 & 0xFF);
  frame[10] = (uint8_t)((val4 >> 8) & 0xFF);

  uint8_t crc = 0;
  for (uint8_t i = 2; i < 11; ++i) crc ^= frame[i];
  frame[11] = crc;

  // Serial.write блокируется, когда 64-байтовый буфер передачи полон, и
  // тогда рушится вся временная сетка. Лучше пропустить кадр, чем сорвать
  // такт: приёмник увидит разрыв по счётчику sequence и точно узнает,
  // сколько кадров потеряно.
  if (Serial.availableForWrite() >= (int)sizeof(frame)) {
    Serial.write(frame, sizeof(frame));
  } else {
    ++tx_full_count;
    health_flag = 0x80;
  }

  sequence = (sequence + 1) & 0x7F;   // 7 бит: значение 0xAA недостижимо
  health_flag = 0;                    // признак сбоя действует один кадр
}
